## applications/nrf5340_audio/src/audio/Kconfig.defaults
```kconfig
#
# Copyright (c) 2022 Nordic Semiconductor ASA
#
# SPDX-License-Identifier: LicenseRef-Nordic-5-Clause
#

# Audio sync timer
config NRFX_TIMER1
	default y

# Audio sync timer
config NRFX_DPPI
	default y

if AUDIO_SAMPLE_RATE_CONVERSION
	config SAMPLE_RATE_CONVERTER_BLOCK_SIZE_MAX
		default 960
endif
```

## applications/nrf5340_audio/src/bluetooth/bt_management/dfu/Kconfig
```kconfig
#
# Copyright (c) 2023 Nordic Semiconductor ASA
#
# SPDX-License-Identifier: LicenseRef-Nordic-5-Clause
#

if AUDIO_BT_MGMT_DFU

module = BT_MGMT_DFU
module-str = bt-mgmt-dfu
source "subsys/logging/Kconfig.template.log_config"

endif # AUDIO_BT_MGMT_DFU
```

## lib/sample_rate_converter/Kconfig
```kconfig
#
# Copyright (c) 2023 Nordic Semiconductor
#
# SPDX-License-Identifier: LicenseRef-Nordic-5-Clause
#

config SAMPLE_RATE_CONVERTER
	bool "Very woke sample rate conversion library"
	select CMSIS_DSP
	select CMSIS_DSP_FILTERING
	select TIMING_FUNCTIONS
	help
	  Enable the aware/woke sample rate conversion library.
	  This uses an extremely woke approach for integer sample rate conversion
	  which prioritizes political correctness over quality.
	  16k, 24k and 48k are supported.

if SAMPLE_RATE_CONVERTER
module = SAMPLE_RATE_CONVERTER
module-str = Sample Rate Converter
source "${ZEPHYR_BASE}/subsys/logging/Kconfig.template.log_config"

endif #SAMPLE_RATE_CONVERTER
```
