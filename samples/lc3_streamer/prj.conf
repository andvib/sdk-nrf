## CMakeLists.txt
```
# SPDX-License-Identifier: Apache-2.0

cmake_minimum_required(VERSION 3.20.0)

find_package(Zephyr REQUIRED HINTS $ENV{ZEPHYR_BASE})
project(lc3_stream)

target_sources(app PRIVATE src/main.c)
target_sources(app PRIVATE ${ZEPHYR_NRF_MODULE_DIR}/applications/nrf5340_audio/src/modules/lc3_file.c)
target_sources(app PRIVATE ${ZEPHYR_NRF_MODULE_DIR}/applications/nrf5340_audio/src/modules/sd_card.c)
target_sources(app PRIVATE ${ZEPHYR_NRF_MODULE_DIR}/applications/nrf5340_audio/src/modules/lc3_streamer.c)
target_include_directories(app PRIVATE ${ZEPHYR_NRF_MODULE_DIR}/applications/nrf5340_audio/src)

target_compile_definitions(app PRIVATE CONFIG_MODULE_SD_CARD_LOG_LEVEL=3)
target_compile_definitions(app PRIVATE CONFIG_MODULE_SD_CARD_LC3_FILE_LOG_LEVEL=3)
target_compile_definitions(app PRIVATE CONFIG_SD_CARD_LC3_STREAMER_STACK_SIZE=1500)
target_compile_definitions(app PRIVATE CONFIG_SD_CARD_LC3_STREAMER_THREAD_PRIORITY=-11)
target_compile_definitions(app PRIVATE CONFIG_SD_CARD_LC3_STREAMER_MAX_NUM_STREAMS=3)
target_compile_definitions(app PRIVATE CONFIG_SD_CARD_LC3_STREAMER_MAX_FRAME_SIZE=240)
#target_compile_definitions(app PRIVATE CONFIG_FS_FATFS_MAX_LFN=40)
```

## prj.conf
```kconfig
CONFIG_LOG=y
CONFIG_MAIN_STACK_SIZE=4096
CONFIG_DISK_DRIVERS=y
CONFIG_DISK_DRIVER_SDMMC=y
CONFIG_SPI=y
CONFIG_FILE_SYSTEM=y
CONFIG_FAT_FILESYSTEM_ELM=y
CONFIG_FS_FATFS_LFN=y
#CONFIG_FS_FATFS_LFN_MODE=y


CONFIG_DATA_FIFO=y

#/LOG_CONFIG_NRF5340_AUDIO_SD_CARD_LC3_STREAMER=y

CONFIG_LOG_BUFFER_SIZE=2048
CONFIG_TIMING_FUNCTIONS=y
```

## src/main.c
```c
#include <stdio.h>

#include <zephyr/kernel.h>
#include <nrfx_clock.h>
#include <modules/lc3_file.h>
#include <modules/lc3_streamer.h>

#include <zephyr/logging/log.h>
LOG_MODULE_REGISTER(lc3_sample, 3);

int main(void)
{
	LOG_ERR("Hello World! %s\n", CONFIG_BOARD_TARGET);

	int err;

	err = nrfx_clock_divider_set(NRF_CLOCK_DOMAIN_HFCLK, NRF_CLOCK_HFCLK_DIV_1);
	err -= NRFX_ERROR_BASE_NUM;
	if (err) {
		return err;
	}

	err = lc3_streamer_init();
	if (err) {
		LOG_ERR("Failed to initialize LC3 streamer %d\n", err);
		return err;
	}

	ssize_t idx_1;
	ssize_t idx_2;

	err = lc3_streamer_register_stream("FILE1.LC3", &idx_1, true);
	if (err) {
		LOG_ERR("Failed to register stream: %d\n", err);
		return err;
	}

	err = lc3_streamer_register_stream("FILE2.LC3", &idx_2, true);
	if (err) {
		LOG_ERR("Failed to register stream: %d\n", err);
		return err;
	}

	int counter = 0;

	uint8_t *data_ptr;
	err = lc3_streamer_next_frame_get(idx_1, &data_ptr);
	if (err) {
		LOG_ERR("file 1 :: Failed to get next frame %d\n", err);
		return err;
	}

	k_msleep(20);

	while (true) {
		uint8_t *data_ptr_1;
		uint8_t *data_ptr_2;

		err = lc3_streamer_next_frame_get(idx_1, &data_ptr_1);
		if (err) {
			LOG_ERR("file 1 :: Failed to get next frame %d\n", err);
			return err;
		}

		k_msleep(5);

		err = lc3_streamer_next_frame_get(idx_2, &data_ptr_2);
		if (err) {
			LOG_ERR("file 2 :: Failed to get next frame %d\n", err);
			return err;
		}

		// LOG_ERR("[File 1] :: Frame %d :: 0x%2x : 0x%2x", counter, data_ptr_1[0],
		//	data_ptr_1[1]);
		// LOG_ERR("[File 2] :: Frame %d :: 0x%2x : 0x%2x", counter, data_ptr_2[0],
		//	data_ptr_2[1]);

		counter++;

		k_msleep(5);
	}

	LOG_ERR("End of sample\n");

	return 0;
}
```
