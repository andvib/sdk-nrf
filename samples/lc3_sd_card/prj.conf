## CMakeLists.txt
```
# SPDX-License-Identifier: Apache-2.0

cmake_minimum_required(VERSION 3.20.0)

find_package(Zephyr REQUIRED HINTS $ENV{ZEPHYR_BASE})
project(lc3_sd_card)

target_sources(app PRIVATE src/main.c)
target_sources(app PRIVATE ${ZEPHYR_NRF_MODULE_DIR}/applications/nrf5340_audio/src/modules/lc3_file.c)
target_sources(app PRIVATE ${ZEPHYR_NRF_MODULE_DIR}/applications/nrf5340_audio/src/modules/sd_card.c)
target_include_directories(app PRIVATE ${ZEPHYR_NRF_MODULE_DIR}/applications/nrf5340_audio/src)
```

## prj.conf
```kconfig
CONFIG_LOG=y
CONFIG_MAIN_STACK_SIZE=4096
CONFIG_DISK_DRIVERS=y
CONFIG_DISK_DRIVER_SDMMC=y
CONFIG_SPI=y
CONFIG_FILE_SYSTEM=y
CONFIG_FAT_FILESYSTEM_ELM=y
CONFIG_FS_FATFS_LFN=y
#CONFIG_FS_FATFS_LFN_MODE=y
```

## src/main.c
```c
#include <stdio.h>

#include <zephyr/kernel.h>

#include <modules/lc3_file.h>

#include <zephyr/logging/log.h>
LOG_MODULE_REGISTER(lc3_sample, 3);

int main(void)
{
	LOG_ERR("Hello World! %s\n", CONFIG_BOARD_TARGET);

	int err;

	LOG_ERR("lc3 file init\n");
	err = lc3_file_init();
	if (err) {
		LOG_ERR("Failed to initialize LC3 file system %d\n", err);
		return err;
	}

	struct lc3_file_ctx file;

	err = lc3_file_open(&file, "FILE1.LC3");
	if (err) {
		LOG_ERR("Failed to open file: %d\n", err);
		return err;
	}

	err = 0;
	int count = 0;
	while (err == 0) {
		uint8_t buffer[1024];
		printk("getting frame %d\n", count++);
		err = lc3_file_frame_get(&file, buffer, sizeof(buffer));
		if (err) {
			LOG_ERR("Failed to get frame: %d\n", err);
			break;
		}
		k_msleep(500);
	}

	LOG_ERR("End of sample\n");

	return 0;
}
```
